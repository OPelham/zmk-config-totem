## config/west.yml
```yaml
manifest:
  remotes:
  # zmk fork with mouse emulation
    - name: zmkfirmware
      url-base: https://github.com/petejohanson
  projects:
    - name: zmk
      remote: zmkfirmware
      revision: feat/pointers-move-scroll
      import: app/west.yml
  self:
    path: config
```
